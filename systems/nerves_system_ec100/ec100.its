## systems/nerves_system_ec100/ec100.its
```
/dts-v1/;

/ {
    description = "Nerves EC100 RK3506J FIT";
    #address-cells = <1>;

    images {
        kernel {
            description = "Linux kernel";
            data = /incbin/("zImage");
            type = "kernel";
            arch = "arm";
            os = "linux";
            compression = "none";
            load = <0x02080000>;
            entry = <0x02080000>;
            hash-1 { algo = "sha256"; };
        };

        fdt {
            description = "IOTRouter EC100 RK3506J device tree";
            data = /incbin/("rk3506-ec100.dtb");
            type = "flat_dt";
            arch = "arm";
            compression = "none";
            // This BSP requires a load address even for the FDT subimage.
            load = <0x06000000>;
            hash-1 { algo = "sha256"; };
        };
    };

    configurations {
        default = "conf";
        conf {
            description = "EC100 Nerves";
            kernel = "kernel";
            fdt = "fdt";
        };
    };
};
```

## systems/nerves_system_ec100/nerves_defconfig
```kconfig
BR2_arm=y
BR2_cortex_a7=y
BR2_ARM_FPU_NEON_VFPV4=y
# BR2_i686 is not set
# BR2_x86_64 is not set

# Use the official Nerves ARMv7 hard-float external toolchain.
# Do not let Buildroot build an i686/native toolchain.
# BR2_TOOLCHAIN_BUILDROOT is not set
BR2_TOOLCHAIN_EXTERNAL=y
BR2_TOOLCHAIN_EXTERNAL_CUSTOM=y
BR2_TOOLCHAIN_EXTERNAL_DOWNLOAD=y
BR2_TOOLCHAIN_EXTERNAL_URL="https://github.com/nerves-project/toolchains/releases/download/v15.3.0/nerves_toolchain_armv7_nerves_linux_gnueabihf-linux_${shell uname -m}-15.3.0-9917D70.tar.xz"
BR2_TOOLCHAIN_EXTERNAL_CUSTOM_PREFIX="armv7-nerves-linux-gnueabihf"
BR2_TOOLCHAIN_EXTERNAL_HEADERS_6_0=y
BR2_TOOLCHAIN_EXTERNAL_CUSTOM_GLIBC=y
# BR2_TOOLCHAIN_EXTERNAL_INET_RPC is not set
BR2_TOOLCHAIN_EXTERNAL_CXX=y
BR2_TOOLCHAIN_EXTERNAL_FORTRAN=y
BR2_TOOLCHAIN_EXTERNAL_OPENMP=y

BR2_TAR_OPTIONS="--no-same-owner"
BR2_BACKUP_SITE="https://dl.nerves-project.org"
BR2_ENABLE_DEBUG=y
BR2_GLOBAL_PATCH_DIR="${BR2_EXTERNAL_NERVES_PATH}/patches ${NERVES_DEFCONFIG_DIR}/bootstrap/patches"
BR2_REPRODUCIBLE=y

# Nerves root filesystem / init setup
BR2_ROOTFS_SKELETON_CUSTOM=y
BR2_ROOTFS_SKELETON_CUSTOM_PATH="${BR2_EXTERNAL_NERVES_PATH}/board/nerves-common/skeleton"
BR2_INIT_NONE=y
BR2_ROOTFS_DEVICE_TABLE="${BR2_EXTERNAL_NERVES_PATH}/board/nerves-common/device_table.txt"
BR2_ENABLE_LOCALE_WHITELIST="locale-archive"
BR2_GENERATE_LOCALE="en_US.UTF-8"
BR2_ROOTFS_OVERLAY="${BR2_EXTERNAL_NERVES_PATH}/board/nerves-common/rootfs_overlay ${NERVES_DEFCONFIG_DIR}/rootfs_overlay"
BR2_ROOTFS_POST_BUILD_SCRIPT="${NERVES_DEFCONFIG_DIR}/post-build.sh ${BR2_EXTERNAL_NERVES_PATH}/board/nerves-common/post-build.sh"
BR2_ROOTFS_POST_IMAGE_SCRIPT="${NERVES_DEFCONFIG_DIR}/post-createfs.sh"
# Nerves 2 uses the tar rootfs when assembling application firmware.
BR2_TARGET_ROOTFS_TAR=y

# RK3506 Linux kernel
BR2_LINUX_KERNEL=y
BR2_LINUX_KERNEL_CUSTOM_TARBALL=y
BR2_LINUX_KERNEL_CUSTOM_TARBALL_LOCATION="https://github.com/armbian/linux-rockchip/archive/428ab2713a61e9bc438eb1e065469797f97953b4.tar.gz"
BR2_LINUX_KERNEL_USE_DEFCONFIG=y
BR2_LINUX_KERNEL_DEFCONFIG="rk3506"
BR2_LINUX_KERNEL_CONFIG_FRAGMENT_FILES="${NERVES_DEFCONFIG_DIR}/linux/ec100.fragment"
BR2_LINUX_KERNEL_DTS_SUPPORT=y
BR2_LINUX_KERNEL_CUSTOM_DTS_DIR="${NERVES_DEFCONFIG_DIR}/dts"
BR2_LINUX_KERNEL_NEEDS_HOST_OPENSSL=y

# Official Rockchip DDR/SPL/TEE; vendor-BSP U-Boot with Nerves boot policy.
# Factory only: normal OTA never changes the low-level chain.
# BR2_TARGET_OPTEE_OS is not set

BR2_TARGET_UBOOT=y
BR2_TARGET_UBOOT_BUILD_SYSTEM_KCONFIG=y
BR2_TARGET_UBOOT_CUSTOM_TARBALL=y
BR2_TARGET_UBOOT_CUSTOM_TARBALL_LOCATION="https://github.com/rockchip-linux/u-boot/archive/1c535d65b8509f388d09e49fb6961f49fda35a1d.tar.gz"
BR2_TARGET_UBOOT_USE_DEFCONFIG=y
BR2_TARGET_UBOOT_BOARD_DEFCONFIG="rk3506"
BR2_TARGET_UBOOT_CONFIG_FRAGMENT_FILES="${NERVES_DEFCONFIG_DIR}/bootstrap/uboot.config.fragment"
BR2_TARGET_UBOOT_CUSTOM_DTS_PATH="${NERVES_DEFCONFIG_DIR}/bootstrap/rk3506-ec100.dts"
BR2_TARGET_UBOOT_NEEDS_DTC=y
BR2_TARGET_UBOOT_NEEDS_PYTHON3=y
BR2_TARGET_UBOOT_NEEDS_PYLIBFDT=y
BR2_TARGET_UBOOT_NEEDS_PYELFTOOLS=y
BR2_TARGET_UBOOT_NEEDS_OPENSSL=y
BR2_TARGET_UBOOT_NEEDS_ROCKCHIP_RKBIN=y
BR2_TARGET_UBOOT_FORMAT_ITB=y
# Source SPL may be built by the BSP but is not installed or packaged.
# BR2_TARGET_UBOOT_SPL is not set
BR2_PACKAGE_ROCKCHIP_RKBIN=y
BR2_PACKAGE_ROCKCHIP_RKBIN_TPL_FILENAME="bin/rk35/rk3506_ddr_750MHz_v1.08.bin"
BR2_PACKAGE_ROCKCHIP_RKBIN_TEE_FILENAME="bin/rk35/rk3506_tee_v2.50.bin"

# Base target packages
BR2_PACKAGE_BUSYBOX_CONFIG="${BR2_EXTERNAL_NERVES_PATH}/board/nerves-common/busybox.config"
BR2_PACKAGE_BRIDGE_UTILS=y
BR2_PACKAGE_E2FSPROGS=y
# BR2_PACKAGE_E2FSPROGS_FSCK is not set
BR2_PACKAGE_CA_CERTIFICATES=y
BR2_PACKAGE_DTC=y
BR2_PACKAGE_LIBMNL=y
# Tailscale's default firewall backend needs both iptables and ip6tables.
BR2_PACKAGE_IPTABLES=y
# BR2_PACKAGE_IPTABLES_NFTABLES is not set
# Required by vintage_net_wifi, included in the standard nerves_pack template.
BR2_PACKAGE_LIBNL=y

# Needed to build the EC100 FIT image in post-createfs.sh
BR2_PACKAGE_HOST_UBOOT_TOOLS=y
BR2_PACKAGE_HOST_UBOOT_TOOLS_FIT_SUPPORT=y

# Nerves
BR2_NERVES_SYSTEM_NAME="nerves_system_ec100"
BR2_NERVES_ADDITIONAL_IMAGE_FILES="${NERVES_DEFCONFIG_DIR}/fwup.conf ${NERVES_DEFCONFIG_DIR}/fwup-ops.conf"
BR2_PACKAGE_NBTTY=y
BR2_PACKAGE_NERVES_CONFIG=y
BR2_PACKAGE_NERVES_CONFIG_ACCEPT_RNG_NOTICE=y
```

## systems/nerves_system_ec100_qemu/nerves_defconfig
```kconfig
BR2_x86_64=y

# Keep the upstream x86 musl toolchain; EC100 uses ARMv7 glibc.
# The compiler generation and Buildroot/OTP baseline match EC100.
# BR2_TOOLCHAIN_BUILDROOT is not set
BR2_TOOLCHAIN_EXTERNAL=y
BR2_TOOLCHAIN_EXTERNAL_CUSTOM=y
BR2_TOOLCHAIN_EXTERNAL_DOWNLOAD=y
BR2_TOOLCHAIN_EXTERNAL_URL="https://github.com/nerves-project/toolchains/releases/download/v15.3.0/nerves_toolchain_x86_64_nerves_linux_musl-linux_${shell uname -m}-15.3.0-EA072ED.tar.xz"
BR2_TOOLCHAIN_EXTERNAL_CUSTOM_PREFIX="$(ARCH)-nerves-linux-musl"
BR2_TOOLCHAIN_EXTERNAL_GCC_15=y
BR2_TOOLCHAIN_EXTERNAL_HEADERS_6_0=y
BR2_TOOLCHAIN_EXTERNAL_CUSTOM_MUSL=y
BR2_TOOLCHAIN_EXTERNAL_CXX=y
BR2_TOOLCHAIN_EXTERNAL_FORTRAN=y
BR2_TOOLCHAIN_EXTERNAL_OPENMP=y

BR2_TAR_OPTIONS="--no-same-owner"
BR2_BACKUP_SITE="https://dl.nerves-project.org"
BR2_ENABLE_DEBUG=y
BR2_GLOBAL_PATCH_DIR="${BR2_EXTERNAL_NERVES_PATH}/patches"
BR2_REPRODUCIBLE=y

# Same Nerves root filesystem/init setup as EC100. musl provides UTF-8
# support without glibc's BR2_GENERATE_LOCALE step.
BR2_ROOTFS_SKELETON_CUSTOM=y
BR2_ROOTFS_SKELETON_CUSTOM_PATH="${BR2_EXTERNAL_NERVES_PATH}/board/nerves-common/skeleton"
BR2_INIT_NONE=y
BR2_ROOTFS_DEVICE_TABLE="${BR2_EXTERNAL_NERVES_PATH}/board/nerves-common/device_table.txt"
BR2_ENABLE_LOCALE_WHITELIST="locale-archive"
BR2_ROOTFS_OVERLAY="${BR2_EXTERNAL_NERVES_PATH}/board/nerves-common/rootfs_overlay ${NERVES_DEFCONFIG_DIR}/rootfs_overlay"
BR2_ROOTFS_POST_BUILD_SCRIPT="${NERVES_DEFCONFIG_DIR}/post-build.sh ${BR2_EXTERNAL_NERVES_PATH}/board/nerves-common/post-build.sh"
BR2_ROOTFS_POST_IMAGE_SCRIPT="${NERVES_DEFCONFIG_DIR}/post-createfs.sh"
BR2_TARGET_ROOTFS_TAR=y

# Upstream x86 kernel and virtio drivers; EC100's vendor kernel is ARM-only.
BR2_LINUX_KERNEL=y
BR2_LINUX_KERNEL_CUSTOM_VERSION=y
BR2_LINUX_KERNEL_CUSTOM_VERSION_VALUE="6.18.36"
BR2_LINUX_KERNEL_USE_CUSTOM_CONFIG=y
BR2_LINUX_KERNEL_CUSTOM_CONFIG_FILE="${NERVES_DEFCONFIG_DIR}/linux-6.18.defconfig"
BR2_LINUX_KERNEL_CONFIG_FRAGMENT_FILES="${NERVES_DEFCONFIG_DIR}/linux/gateway.fragment"
BR2_LINUX_KERNEL_XZ=y
BR2_LINUX_KERNEL_INSTALL_TARGET=y
BR2_LINUX_KERNEL_NEEDS_HOST_LIBELF=y

# Same gateway userspace as EC100, without board-specific device-tree tools.
BR2_PACKAGE_BUSYBOX_CONFIG="${BR2_EXTERNAL_NERVES_PATH}/board/nerves-common/busybox.config"
BR2_PACKAGE_BRIDGE_UTILS=y
BR2_PACKAGE_E2FSPROGS=y
# BR2_PACKAGE_E2FSPROGS_FSCK is not set
BR2_PACKAGE_CA_CERTIFICATES=y
BR2_PACKAGE_LIBMNL=y
BR2_PACKAGE_IPTABLES=y
# BR2_PACKAGE_IPTABLES_NFTABLES is not set
BR2_PACKAGE_LIBNL=y

# GRUB/MBR and FAT boot partition are specific to QEMU, not EC100's U-Boot/GPT.
BR2_TARGET_GRUB2=y
BR2_TARGET_GRUB2_BUILTIN_MODULES_PC="boot linux ext2 squash4 fat part_msdos normal biosdisk loadenv echo true test sleep"
BR2_TARGET_GRUB2_INSTALL_TOOLS=y
BR2_PACKAGE_HOST_DOSFSTOOLS=y

BR2_NERVES_SYSTEM_NAME="nerves_system_ec100_qemu"
BR2_NERVES_ADDITIONAL_IMAGE_FILES="${NERVES_DEFCONFIG_DIR}/fwup.conf ${NERVES_DEFCONFIG_DIR}/fwup-ops.conf"
BR2_PACKAGE_NBTTY=y
BR2_PACKAGE_NERVES_CONFIG=y
BR2_PACKAGE_NERVES_CONFIG_ACCEPT_RNG_NOTICE=y
```

## systems/nerves_system_em300/em300.its
```
/dts-v1/;

/ {
    description = "Nerves EM300 RK3506 FIT";
    #address-cells = <1>;

    images {
        kernel {
            description = "Linux kernel";
            data = /incbin/("zImage");
            type = "kernel";
            arch = "arm";
            os = "linux";
            compression = "none";
            load = <0x02080000>;
            entry = <0x02080000>;
            hash-1 { algo = "sha256"; };
        };

        fdt {
            description = "IOTRouter EM300 RK3506 device tree";
            data = /incbin/("rk3506-em300.dtb");
            type = "flat_dt";
            arch = "arm";
            compression = "none";
            // This BSP requires a load address even for the FDT subimage.
            load = <0x06000000>;
            hash-1 { algo = "sha256"; };
        };
    };

    configurations {
        default = "conf";
        conf {
            description = "EM300 Nerves";
            kernel = "kernel";
            fdt = "fdt";
        };
    };
};
```

## systems/nerves_system_em300/package/aic8800/Config.in
```kconfig
config BR2_PACKAGE_AIC8800
	bool "aic8800"
	depends on BR2_LINUX_KERNEL
	help
	  AIC8800 USB Wi-Fi and Bluetooth drivers and AIC8800D80 firmware,
	  from Radxa's packaging of the vendor SDK.

	  https://github.com/radxa-pkg/aic8800
```
